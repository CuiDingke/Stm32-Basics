/*******************************************************************************
** 文件名: 		main.c
** 版本：  		1.0
** 工作环境: 	RealView MDK-ARM 4.20
** 作者: 		河南科技学院
** 生成日期: 	2012-02-10
** 功能:		模版程序（用户可以在这里简单说明工程的功能）
** 相关文件:	无
** 修改日志：	2012-02-10   创建文档
*******************************************************************************/
/* 包含头文件 *****************************************************************/
#include "stm32f10x.h"
#include "tim.h"
extern uint32_t sum;
void delay(__IO u32 j);
/* 类型声明 ------------------------------------------------------------------*/
/* 宏定义 --------------------------------------------------------------------*/

/* 变量 ----------------------------------------------------------------------*/


/* 函数声明 ------------------------------------------------------------------*/
/* 函数功能 ------------------------------------------------------------------*/

/*******************************************************************************
  * @函数名称	main
  * @函数说明   主函数 
  * @输入参数   无
  * @输出参数   无
  * @返回参数   无
  *****************************************************************************/
int main(void)
{

uint32_t i;
    while (1)
    {
			for(i=0;i<1000;i=i+10)
			{
		 	  tim3_Init(i);
delay(0x0fFFff);
			}
			if(i==1000)
			{
			  for(i=1000;i>0;i=i-10)
			{
		 tim3_Init(i);
				delay(0x0fFFff);
			}
			}
    }
}
void delay(__IO u32 j)
{
for(; j!=0; j--);
}



/***********************************文件结束***********************************/
