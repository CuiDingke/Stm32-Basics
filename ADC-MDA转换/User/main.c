/*******************************************************************************
** 文件名: 		main.c
** 版本：  		1.0
** 工作环境: 	RealView MDK-ARM 4.20
** 作者: 		河南科技学院
** 生成日期: 	2012-02-10
** 功能:		模版程序（用户可以在这里简单说明工程的功能）
** 相关文件:	无
** 修改日志：	2012-02-10   创建文档
*******************************************************************************/
/* 包含头文件 *****************************************************************/
//#include "stm32f10x.h"
//#include "adc.h"
//#include "bsp_usart1.h"
////#include "stdio.h"
//extern uint16_t ADCConvertedValue[2];
// float a,b;
/* 类型声明 ------------------------------------------------------------------*/
/* 宏定义 --------------------------------------------------------------------*/

/* 变量 ----------------------------------------------------------------------*/


/* 函数声明 ------------------------------------------------------------------*/
/* 函数功能 ------------------------------------------------------------------*/

/*******************************************************************************
  * @函数名称	main
  * @函数说明   主函数 
  * @输入参数   无
  * @输出参数   无
  * @返回参数   无
  *****************************************************************************/
//int main(void)
//{
//   ADC_config();
//	USART1_Config();
//    while (1)
//    {
//		  a=ADCConvertedValue[0]*3.3/4096;/*单个采集*/
//			printf("c1 :%.2f \r\n",a);
//			b=ADCConvertedValue[1]*3.3/4096;
//			printf("c2 :%.2f \r\n",b);	
//    }
//}

#include "stm32f10x.h"
#include "adc.h"
#include "stdio.h"
#include "bsp_usart1.h"
#include "stdio.h"
extern uint16_t ADCConvertedValue[2];
uint16_t i[10];
uint16_t j[10];
uint16_t c,d;
void delay(__IO u32 v);
 float a=0,b=0,e,f;
int main(void)
{
   ADC_config();
	USART1_Config();
    while (1)
    {
		 
//		 for(c=0;c<9;c++)/*多通道依次采十次平均*/
//		 {
//			 a=ADCConvertedValue[0]*3.3/4096;
//			 b=b+a; 
//		 }
//		 b=b/10.00;
//		printf("c1 :%.2f \r\n",b);
			
			
			
//		 
//		 for(d=0;d<9;d++)
//		 {
//			 e=ADCConvertedValue[1]*3.3/4096;
//			 f=f+e; 
//		 }
//		 f=f/10.00;
//		printf("c2 :%.2f \r\n",f);
			
			for(c=0;c<9;c++)/*多通道同时采十次求平均*/
		 {
			 a=ADCConvertedValue[0]*3.3/4096;
			 e=ADCConvertedValue[1]*3.3/4096;
			 b=b+a;
       f=f+e;			 
		 }
		 b=b/10.00;
		 f=b/10.00;
		printf("c1 :%.2f \r\n",b);
		 delay(0x5fffff);
		printf("c2 :%.2f \r\n",f); 
		 delay(0x5fffff);
		
////     for(d=0;d<10;d++)
////		 { 
////			 i[d]=ADCConvertedValue[1]*3.3/4096;
////		 b+=i[d];

////		 }
////		 		 f=b/10.00;
////	   printf("c2 :%.2f \r\n",f);
    }

//   ADC_config();
//	USART1_Config();

//while(1)
//{
//for(c=0;c<9;c++)/*单通道十次求平均*/
//	{
//    a=ADCConvertedValue*3.3/4096;
//    b=b+a;
//}
//b=b/10.00;
//printf("%.2f\r\n",b);


//}










}


void delay(__IO u32 v)
{
for(; v!=0;v--);
}
